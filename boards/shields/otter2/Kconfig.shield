## boards/shields/otter2/Kconfig.shield
```kconfig
config SHIELD_OTTER2_LEFT
    def_bool $(shields_list_contains,otter2_left)

config SHIELD_OTTER2_RIGHT
    def_bool $(shields_list_contains,otter2_right)

config SHIELD_OTTER2_DONGLE
    def_bool $(shields_list_contains,otter2_dongle)
```
